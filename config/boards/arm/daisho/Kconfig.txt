## config/boards/arm/daisho/Kconfig.txt
```kconfig
# Daisho board configuration

# Copyright (c) 2020 The ZMK Contributors
# SPDX-License-Identifier: MIT

config BOARD_DAISHO
	bool "Daisho"
	depends on SOC_NRF52840_QIAA
```

## config/boards/arm/daishopad/Kconfig.txt
```kconfig
# DaishoPad board configuration

# Copyright (c) 2020 The ZMK Contributors
# SPDX-License-Identifier: MIT

config BOARD_DAISHOPAD
	bool "DaishoPad"
	depends on SOC_NRF52840_QIAA
```

## config/boards/arm/gw01_macro/Kconfig.defconfig
```kconfig
# GW01 (macro) board configuration

# Copyright (c) 2020 The ZMK Contributors
# SPDX-License-Identifier: MIT

if BOARD_GW01_MACRO

config ZMK_KEYBOARD_NAME
	default "DaishoPad"

if USB

config USB_NRFX
	default y

config USB_DEVICE_STACK
	default y

endif # USB

config BT_CTLR
	default BT

config ZMK_BLE
	default y

config ZMK_USB
	default y

config ZMK_BATTERY_VOLTAGE_DIVIDER
	default y

endif # BOARD_GW01_MACRO
```

## config/boards/arm/gw01_macro/Kconfig.txt
```kconfig
# GW01 (macro) board configuration

# Copyright (c) 2020 The ZMK Contributors
# SPDX-License-Identifier: MIT

config BOARD_GW01_MACRO
	bool "GW01 (Macro)"
	depends on SOC_NRF52840_QIAA
```

## config/boards/arm/gw01_main/Kconfig.defconfig
```kconfig
# GW01 (main) board configuration

# Copyright (c) 2020 The ZMK Contributors
# SPDX-License-Identifier: MIT

if BOARD_GW01_MAIN

config ZMK_KEYBOARD_NAME
	default "GW01 (Main)"

if USB

config USB_NRFX
	default y

config USB_DEVICE_STACK
	default y

endif # USB

config BT_CTLR
	default BT

config ZMK_BLE
	default y

config ZMK_USB
	default y

config ZMK_BATTERY_VOLTAGE_DIVIDER
	default y

endif # BOARD_GW01_MAIN
```

## config/boards/arm/gw01_main/Kconfig.txt
```kconfig
# GW01 (main) board configuration

# Copyright (c) 2020 The ZMK Contributors
# SPDX-License-Identifier: MIT

config BOARD_GW01_MAIN
	bool "GW01 (Main)"
	depends on SOC_NRF52840_QIAA
```
